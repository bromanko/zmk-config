#include <behaviors.dtsi>
#include <dt-bindings/zmk/keys.h>

/ {
    sensors {
        compatible = "zmk,keymap-sensors";
        sensors = <&encoder_4>;
    };

    keymap {
        compatible = "zmk,keymap";

        default_layer {
            bindings = <
    // Rooms mute audio, Rooms mute video, Zoom mute audio, Zoom mute video
    &kp LA(M) &kp LA(V) &kp M &kp V &kp K_MUTE
            >;

            sensor-bindings = <&inc_dec_kp C_VOL_DN C_VOL_UP>;
        };
    };
};
